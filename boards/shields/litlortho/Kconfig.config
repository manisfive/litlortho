## boards/shields/litlortho/Kconfig.shield
```kconfig
#Copyright (c) 2021 The ZMK Contributors
# SPDX-License-Identifier: MIT
#
 config SHIELD_LITLORTHO
     def_bool $(shields_list_contains,litlortho)
```
